## drivers/usb/serial/exar/Kconfig
```kconfig
config USB_SERIAL_XR21V1410
	tristate "USB EXAR XR21V1410 USB UART Driver"
	default n
	help
	  Say Y here if you want to use an XR21V1410 USB to UART converters.
```
